//*****************************************************************
//
// XLINK command file for IAR Embedded Workbench for MSP430.
//
// This file should be used with the CC430F6137 microprocessor.
//
// Copyright 1996-2007 IAR Systems. All rights reserved.
//
// Usage:  xlink your_file(s) -f lnkcc430f6137 library
//
// $Revision: 1.30 $
//
//*****************************************************************

//*****************************************************************
//
// The memory areas of the CC430F6137 microprocessor:
//
//   Peripheral units:                0 - 01FF
//
//   Information memory (FLASH):   1800 - 19FF
//
//   Read-write memory (RAM):      1C00 - 2BFD
//
//   Read-only memory (FLASH):     8000 - FF7F
//                                 
//
//*****************************************************************

//*****************************************************************
//
// The following segments are defined in this linker command file:
//
// Data read/write segments (RAM)
// ==============================
//
// segment     Restrictions    Usage
// -------     ------------    --------------------------
// DATA16_I    < 10000         Data16 initialized variables
// DATA16_Z    < 10000         Data16 zero initialized variables
// DATA16_N    < 10000         Data16 uninitialized variables
// DATA16_HEAP < 10000         Data16 heap used by malloc and free
// DATA20_I                    Data20 initialized variables
// DATA20_Z                    Data20 zero initialized variables
// DATA20_N                    Data20 uninitialized variables
// DATA20_HEAP                 Data20 heap used by malloc and free
// CSTACK      < 10000         Runtime stack
//
//
// Program and data read-only segments (FLASH)
// ===========================================
//
// segment     Restrictions    Usage
// -------     ------------    --------------------------
// INFO                        Information memory
// CSTART      < 10000         Program startup code
// CODE                        Program code
// ISR_CODE    < 10000         Program code for interrupt service routines
// DATA16_C    < 10000         Data16 constant data and string literals
// DATA16_ID   < 10000         Data16 initializers for DATA16_I
// DATA20_C                    Data20 constant data and string literals
// DATA20_ID                   Data20 initializers for DATA20_I
// DIFUNCT     < 10000         Dynamic initialization vector used by C++
// CHECKSUM                    Checksum byte(s) generated by the -J option
// INTVEC      FF80-FFFF       Interrupt vectors
// RESET       FFFE-FFFF       The reset vector
//
//*****************************************************************


// ---------------------------------------------------------
// Stack and heap sizes.
// ---------------------------------------------------------

// Uncomment for command line use
//-D_STACK_SIZE=80
//-D_DATA16_HEAP_SIZE=80


// ---------------------------------------------------------
// Define cpu.
// ---------------------------------------------------------

-cmsp430


// ---------------------------------------------------------
// Read-write memory.
// ---------------------------------------------------------

-Z(DATA)DATA16_I,DATA16_Z,DATA16_N,DATA16_HEAP+_DATA16_HEAP_SIZE=1C00-2B79
-Z(DATA)CSTACK+_STACK_SIZE#

-Z(DATA)RAM_INTERRUPT_VECTOR=2B80-2BFF


// ---------------------------------------------------------
// Read only memory


// ---------------------------------------------------------
// Information memory
// ---------------------------------------------------------

-Z(CODE)INFO=1800-19FF
-Z(CODE)INFOA=1980-19FF
-Z(CODE)INFOB=1900-197F
-Z(CODE)INFOC=1880-18FF
-Z(CODE)INFOD=1800-187F

// -------------------------------------------------------------------
//  BSL Memory
// -------------------------------------------------------------------
-Z(CODE)ZAREA=1000-1005
-Z(CODE)ZAREA_CODE=1006-102F
-Z(CODE)BSL0=1006-11FF
-Z(CODE)BSL1=1200-13FF
-Z(CODE)BSL2=1400-15FF
-Z(CODE)BSL3=1600-17EF


// ---------------------------------------------------------
// Code
// ---------------------------------------------------------

-Z(CODE)CSTART,ISR_CODE=1020-17EF

// ---------------------------------------------------------
// Constant data
// ---------------------------------------------------------

-Z(CONST)DATA16_C,DATA16_ID,DIFUNCT,CHECKSUM=1020-17EF


// ---------------------------------------------------------
// Code
// ---------------------------------------------------------
-P(CODE)CODE=1006-17EF


// ---------------------------------------------------------
// Interrupt vectors
// ---------------------------------------------------------
-Z(CODE)INTVEC=FF80-FFFF
-Z(CODE)RESET=FFD8-FFD9

-Z(CONST)BSLSIG=0x17F0-17FB
  //  contains:
  //  BSL Start Vector             
  //  BSL Unlock Function Vector   
  //  BSL Unlock Signature 1       
  //  BSL Unlock Signature 2       

-Z(CONST)JTAGLOCK_KEY=0x17FC-17FF
  //  if it contains:
  //  0x0000 0x0000 or
  //  0xFFFF 0xFFFF the JTAG will be unlocked otherwise JTAG is locked

// ---------------------------------------------------------
// The end
// ---------------------------------------------------------
